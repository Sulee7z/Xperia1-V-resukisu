## kernel_platform/common/drivers/perf_mgr/Kconfig
```kconfig
config PERF_MGR
	tristate "FPS-driven energy-aware frequency governor"
	default y
	help
	  FPS-driven energy-aware scheduling (FEAS-like).
	  Userspace reports rendered frame timings via /dev/perf_manager;
	  kernel computes required CPU capacity to hit target FPS and
	  adjusts frequency accordingly.
	  Ported from Samsung GPIS, adapted for GKI 5.15.
```
